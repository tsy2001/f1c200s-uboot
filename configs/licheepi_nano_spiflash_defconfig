## configs/licheepi_nano_spiflash_defconfig
```kconfig
CONFIG_ARM=y
CONFIG_ARCH_SUNXI=y
CONFIG_USE_BOOTCOMMAND=y
CONFIG_BOOTCOMMAND="sf probe 0 50000000;sf read 0x80C00000 0x100000 0x4000;sf read 0x80008000 0x110000 0x400000;bootz 0x80008000 - 0x80C00000"
CONFIG_CMD_BOOTZ=y
CONFIG_SYS_TEXT_BASE=0x81700000
CONFIG_ENV_IS_IN_SPI_FLASH=y
CONFIG_ENV_SIZE=0x8000
CONFIG_ENV_OFFSET=0x70000
CONFIG_ENV_SECT_SIZE=0x1000
CONFIG_MACH_SUNIV=y
CONFIG_MISC_INIT_R=y
CONFIG_SUNIV_OLED=y
CONFIG_DRAM_CLK=156
CONFIG_DRAM_ZQ=0
CONFIG_DEFAULT_DEVICE_TREE="suniv-f1c100s-licheepi-nano"
CONFIG_SPL=y
CONFIG_CMD_SF=y
CONFIG_CMD_SPI=y
CONFIG_DM_SPI_FLASH=y
CONFIG_SPI_FLASH=y
CONFIG_SPI_FLASH_BAR=y
CONFIG_SPI_FLASH_GIGADEVICE=y
CONFIG_SPI_FLASH_MACRONIX=y
CONFIG_SPI_FLASH_WINBOND=y
CONFIG_SF_DEFAULT_SPEED=50000000
CONFIG_SPL_SPI_SUNXI=y
CONFIG_DM_SPI=y
CONFIG_SPI=y
CONFIG_SUN6I_SPI=y
# CONFIG_SPI_SUNXI is not set
# CONFIG_ENV_IS_IN_FAT is not set
# CONFIG_DISTRO_DEFAULTS is not set
# CONFIG_VIDEO_SUNXI is not set
# CONFIG_SPL_DM_SERIAL is not set
# CONFIG_CMD_FLASH is not set
# CONFIG_CMD_FPGA is not set
```
